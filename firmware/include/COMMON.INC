IDMANUF           DEFR	0F07Eh
IDCHIP            DEFR	0F07Ch
XPERCON           EQU   0F024h

FW2BASE	          EQU  0E000h  ;  0F600h 0E000h
FW2END	          EQU  0E7FFh  ;  0F9FFh 0E7FFh
FW2DATA		  	  EQU  (FW2END + 1 - 42)
	
FW1BASE           EQU  0FA40h

STACK_TOP	      EQU  0FC00h
STACK_BOTTOM      EQU  (STACK_TOP - 256d)	; 256 bytes

REGBANK0          EQU  STACK_TOP
REGBANK1		  EQU  (REGBANK0 + 32d)

CMD_PING		  EQU  00h
CMD_ERASE_BLOCKS  EQU  01h
CMD_READ          EQU  02h
CMD_WRITE         EQU  03h
CMD_IDENTIFY      EQU  04h
CMD_ERASE_CHIP    EQU  05h

SHELL_ACK    	  EQU  0ABh

RET_SERIAL_OVERRUN EQU 20h
RET_BAD_ECHO       EQU 21h
RET_ERASE_ERROR    EQU 30h
RET_WRITE_ERROR	   EQU 31h	
	
